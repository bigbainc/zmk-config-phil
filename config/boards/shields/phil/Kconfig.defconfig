## config/boards/shields/phil/Kconfig.defconfig
```kconfig
if SHIELD_PHIL_LEFT

config ZMK_PHIL
    default "phil"

config ZMK_SPLIT_ROLE_CENTRAL
    default y

endif

if SHIELD_PHIL_LEFT || SHIELD_PHIL_RIGHT

config ZMK_SPLIT
    default y

endif
```

## config/boards/shields/phil/Kconfig.shield
```kconfig
config SHIELD_PHIL_LEFT
    def_bool $(shields_list_contains,phil_left)

config SHIELD_PHIL_RIGHT
    def_bool $(shields_list_contains,phil_right)
```

## config/boards/shields/phil_left/Kconfig.defconfig
```kconfig
if SHIELD_PHIL_LEFT

config ZMK_KEYBOARD_NAME
    default "phil_left"
    
endif
```

## config/boards/shields/phil_right/Kconfig.defconfig
```kconfig
if SHIELD_PHIL_RIGHT

config ZMK_KEYBOARD_NAME
    default "phil_right"
    
endif
```
